## CMakeLists.txt
```
cmake_minimum_required(VERSION 3.20.0)
find_package(Zephyr REQUIRED HINTS $ENV{ZEPHYR_BASE})
project(bl350_hello LANGUAGES C)
target_sources(app PRIVATE src/main.c)
```

## prj.conf
```kconfig
# No serial console reaches this board's M4F, so "hello world" goes to a RAM
# ring that Linux publishes at /sys/kernel/debug/remoteproc/<M4F>/trace0.
# The resource table that makes that ring visible comes from OPENAMP_RSC_TABLE.
CONFIG_OPENAMP=y
CONFIG_OPENAMP_MASTER=n
CONFIG_OPENAMP_RSC_TABLE=y

CONFIG_LOG=y
CONFIG_LOG_MODE_MINIMAL=y
CONFIG_LOG_DEFAULT_LEVEL=4
CONFIG_CONSOLE=y
CONFIG_RAM_CONSOLE=y
CONFIG_RAM_CONSOLE_BUFFER_SIZE=2048
CONFIG_UART_CONSOLE=n
CONFIG_BOOT_BANNER=n

# Nothing here writes a UART, but Kconfig aborts without it: the AM62x M4 SoC
# definition unconditionally selects a NS16550 option that depends on
# CONFIG_SERIAL. See m4f/ipc-hello/prj.conf for the exact error.
CONFIG_SERIAL=y
```

## src/main.c
```c
/*
 * Copyright (c) 2026 Chrispine Tinega <dev@chrispinetinega.com>
 *
 * SPDX-License-Identifier: Apache-2.0
 */

/*
 * The smallest thing that proves the toolchain, the board and the boot path.
 *
 * The board target am62x_m4_bl350/am6254/m4 comes from mainline Zephyr
 * (zephyrproject-rtos/zephyr#113302), so this builds with no fork and no
 * BOARD_ROOT.
 *
 * Output goes to the RAM console, not a UART. Read it from Linux with:
 *   cat /sys/kernel/debug/remoteproc/<M4F>/trace0
 */

#include <zephyr/kernel.h>
#include <zephyr/logging/log.h>

LOG_MODULE_REGISTER(hello, CONFIG_LOG_DEFAULT_LEVEL);

int main(void)
{
	LOG_INF("Hello World from Zephyr on the Cortex-M4F!");
	LOG_INF("board: " CONFIG_BOARD_TARGET);

	for (unsigned int tick = 1;; tick++) {
		k_sleep(K_SECONDS(5));
		LOG_INF("still alive — tick %u, uptime %lld ms", tick,
			k_uptime_get());
	}

	return 0;
}
```
